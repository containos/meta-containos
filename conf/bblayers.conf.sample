## conf/bblayers.conf.sample
```bitbake
# LAYER_CONF_VERSION is increased each time build/conf/bblayers.conf
# changes incompatibly
LCONF_VERSION = "6"
gittop := "##OEROOT##/.."

BBPATH = "${TOPDIR}"
BBFILES ?= ""

BBLAYERS ?= " \
  ${gittop}/oe-core/meta \
  ${gittop}/meta-openembedded/meta-oe \
  ${gittop}/meta-openembedded/meta-networking \
  ${gittop}/meta-openembedded/meta-filesystems \
  ${gittop}/meta-openembedded/meta-python \
  ${gittop}/meta-go \
  ${gittop}/meta-sunxi \
  ${gittop}/meta-virtualization \
  ${gittop}/meta-containos \
  "

BBLAYERS_NON_REMOVABLE ?= " \
  ${gittop}/oe-core/meta \
  "
```

## conf/distro/containos.conf
```bitbake
#@--------------------------------------------------------------------
#@TYPE: Distribution
#@NAME: ContainOS
#@DESCRIPTION: Container-based minimal distro
#@MAINTAINER: Angus Lees <gus@inodes.org>
#@--------------------------------------------------------------------

DISTRO_NAME = "containos"
DISTRO_VERSION ?= "v${@time.strftime('%Y.%m', time.gmtime())}"
MAINTAINER = "Angus Lees <gus@inodes.org>"

require conf/distro/include/sane-srcdates.inc
require conf/distro/include/sane-srcrevs.inc
require conf/distro/include/containos-preferred-versions.inc

USE_NLS = "no"
DISTRO_FEATURES = "ext4 largefile usbhost wifi xattr pci acl \
                   ${DISTRO_FEATURES_LIBC}"

FEED_BASEPATH = "feeds/next/apks/"

IMAGE_LINGUAS ?= "en-us"

include conf/distro/include/${TARGET_ARCH}-defaults.inc
include conf/distro/machine/${MACHINE}.conf

# ContainOS uses systemd
DISTRO_FEATURES += "systemd"
VIRTUAL-RUNTIME_init_manager = "systemd"
VIRTUAL-RUNTIME_dev_manager = "systemd"
DISTRO_FEATURES_BACKFILL_CONSIDERED = "sysvinit"
# Remove sysvinit init scripts altogether
VIRTUAL-RUNTIME_initscripts = ""

# Rely on systemd-networkd for network setup
PACKAGECONFIG_append_pn-systemd = " resolved networkd seccomp"

DISTRO_EXTRA_RDEPENDS += "\
    docker \
    ca-certificates \
    kubelet \
    cri-tools \
    nfs-utils-client \
    toolbox \
    bootstrap-autorun \
    "
```

## conf/distro/include/containos-preferred-versions.inc
```bitbake
# A number of recipes (godep, kubernetes) assume go >=1.6 for ./vendor/
# Go 1.10 shared runtime is broken: https://github.com/golang/go/issues/24640
GOVERSION = "1.9%"
```

## conf/distro/include/maintainers.inc
```bitbake
RECIPE_MAINTAINER_pn-godep = "Angus Lees <gus@inodes.org>"
RECIPE_MAINTAINER_pn-kubernetes = "Angus Lees <gus@inodes.org>"
RECIPE_MAINTAINER_pn-libseccomp = "Angus Lees <gus@inodes.org>"
RECIPE_MAINTAINER_pn-docker = "Angus Lees <gus@inodes.org>"
RECIPE_MAINTAINER_pn-docker-containerd = "Angus Lees <gus@inodes.org>"
RECIPE_MAINTAINER_pn-docker-runc = "Angus Lees <gus@inodes.org>"
```

## conf/distro/include/package_regex_containos.inc
```bitbake
# package_regex_containos.inc - This file contains data that tracks
# upstream project associated with a given recipe. This list is needed
# for recipes that version information can not be automagically discovered.
# As we automate this checking, this file will slowly be reduced.
#
# This data is used by the auto-upgrade-helper, to use it, you could
# add the following to your conf/local.conf:
#   --------------- snip ---------------
#   INHERIT =+ "distrodata"
#   require conf/distro/include/package_regex_containos.inc
#   --------------- snip ---------------
#
# Fore more details about auto-upgrade-help, please refer to:
#   http://git.yoctoproject.org/cgit/cgit.cgi/auto-upgrade-helper/tree/README
#
# The format is as a bitbake variable override for each recipe
#
#       REGEX_URI_pn-<recipe name> = "recipe_url"
#	 - This is the url used by the package checking system to
#	   get the latest version of the package
#       REGEX_pn-<recipe name> = "package_regex"
#	 - This is the regex the package checking system uses to
#	   parse the page found at REGEX_URI_pn-<recipe name>
#

REGEX_URI_pn-rkt = "https://github.com/coreos/rkt/releases"
REGEX_pn-rkt = "v(?P<pver>(\d+[\.-_]*)+)\.tar\.gz"

REGEX_URI_pn-libseccomp = "https://github.com/seccomp/libseccomp/releases"
REGEX_pn-libseccomp = "v(?P<pver>(\d+[\.-_]*)+)\.tar\.gz"

REGEX_URI_pn-godep = "https://github.com/tools/godep/releases"
REGEX_pn-godep = "v(?P<pver>(\d+[\.-_]*)+)\.tar\.gz"

REGEX_URI_pn-kubernetes = "https://github.com/kubernetes/kubernetes/releases"
REGEX_pn-kubernetes = "v(?P<pver>(\d+[\.-_]*)+)\.tar\.gz"

REGEX_URI_pn-docker-containerd = "https://github.com/docker/containerd/releases"
REGEX_pn-docker-containerd = "v(?P<pver>(\d+[\.-_]*)+)\.tar\.gz"

REGEX_URI_pn-docker-runc = "https://github.com/docker/runc/releases"
REGEX_pn-docker-runc = "v(?P<pver>(\d+[\.-_]*)+)\.tar\.gz"
```

## conf/distro/machine/bananapi.conf
```bitbake
IMAGE_BOOT_FILES ?= "\
	${KERNEL_DEVICETREE} \
	boot.scr \
	"

WKS_FILE = "sdimage-dualboot.wks.in"

# sdimage-dualboot uses --fixed-size=${ROOT_SIZE}K root partitions
ROOT_SIZE="${@ 400*1024}"
IMAGE_ROOTFS_MAXSIZE = "${ROOT_SIZE}"

CORE_IMAGE_EXTRA_INSTALL += "u-boot-fw-utils rauc dosfstools"
```

## conf/layer.conf
```bitbake
# We have a conf and classes directory, append to BBPATH
BBPATH .= ":${LAYERDIR}"

# We have a recipes directory, add to BBFILES
BBFILES += "${LAYERDIR}/recipes-*/*/*.bb \
	    ${LAYERDIR}/recipes-*/*/*.bbappend"

BBFILE_COLLECTIONS += "containos-layer"
BBFILE_PATTERN_containos-layer := "^${LAYERDIR}/"
BBFILE_PRIORITY_containos-layer = "8"

LAYERVERSION_containos-layer = "1"

LAYERDEPENDS_containos-layer = "core"
LAYERDEPENDS_containos-layer += "networking-layer"
LAYERDEPENDS_containos-layer += "go"

require conf/distro/include/meta_containos_security_flags.inc
```
